## conf/machine/beaglebone-yocto-son.conf
```bitbake
require conf/machine/beaglebone-yocto.conf

MACHINEOVERRIDES =. "beaglebone-yocto:"
WKS_FILE = "beaglebone-yocto-son.wks"

IMAGE_INSTALL:append = " i2c-tools kernel-modules evtest tslib tslib-tests tslib-calibrate ttf-dejavu-sans qtbase qtbase-plugins fontconfig libgpiod libgpiod-tools" 
PACKAGECONFIG_DISTRO:append:pn-qtbase = " linuxfb tslib fontconfig"
INHERIT:append:pn-core-image-full-cmdline = " populate_sdk_qt5"
TOOLCHAIN_HOST_TASK:append = " nativesdk-packagegroup-qt5-toolchain-host nativesdk-cmake"
TOOLCHAIN_TARGET_TASK:append = " packagegroup-qt5-toolchain-target"

SERIAL_CONSOLES = "115200;ttyS1"

BB_NUMBER_THREADS = "4"
PARALLEL_MAKE = "-j4"
```
